#include <avr/pgmspace.h>
#include "programs.h"
const PROGMEM line program_hangman[] = {
{10, "PRINT TAB(32);\"HANGMAN\"\n"},
{20, "PRINT TAB(15);\"CREATIVE COMPUTING  MORRISTOWN, NEW JERSEY\"\n"},
{25, "PRINT:PRINT:PRINT\n"},
{30, "DIM P$(12,12),L$(20),D$(20),N$(26),U(50)\n"},
{40, "C=1: N=50\n"},
{50, "FOR I=1 TO 20: D$(I)=\"-\": NEXT I: M=0\n"},
{60, "FOR I=1 TO 26: N$(I)=\"\": NEXT I\n"},
{70, "FOR I=1 TO 12: FOR J=1 TO 12: P$(I,J)=\" \": NEXT J: NEXT I\n"},
{80, "FOR I=1 TO 12: P$(I,1)=\"X\": NEXT I\n"},
{90, "FOR I=1 TO 7: P$(1,I)=\"X\": NEXT I: P$(2,7)=\"X\"\n"},
{95, "IF C<N THEN 100\n"},
{97, "PRINT \"YOU DID ALL THE WORDS!!\": STOP\n"},
{100, "Q=INT(N*RND(1))+1\n"},
{110, "IF U(Q)=1 THEN 100\n"},
{115, "U(Q)=1: C=C+1: RESTORE: T1=0\n"},
{150, "FOR I=1 TO Q: READ A$: NEXT I\n"},
{160, "L=LEN(A$): FOR I=1 TO LEN(A$): L$(I)=MID$(A$,I,1): NEXT I\n"},
{170, "PRINT \"HERE ARE THE LETTERS YOU USED:\"\n"},
{180, "FOR I=1 TO 26: PRINT N$(I);: IF N$(I+1)=\"\" THEN 200\n"},
{190, "PRINT \",\";: NEXT I\n"},
{200, "PRINT: PRINT: FOR I=1 TO L: PRINT D$(I);: NEXT I: PRINT: PRINT\n"},
{210, "INPUT \"WHAT IS YOUR GUESS\";G$: R=0\n"},
{220, "FOR I=1 TO 26: IF N$(I)=\"\" THEN 250\n"},
{230, "IF G$=N$(I) THEN PRINT \"YOU GUESSED THAT LETTER BEFORE!\": GOTO 170\n"},
{240, "NEXT I: PRINT \"PROGRAM ERROR.  RUN AGAIN.\": STOP\n"},
{250, "N$(I)=G$: T1=T1+1\n"},
{260, "FOR I=1 TO L: IF L$(I)=G$ THEN 280\n"},
{270, "NEXT I: IF R=0 THEN 290\n"},
{275, "GOTO 300\n"},
{280, "D$(I)=G$: R=R+1: GOTO 270\n"},
{290, "M=M+1: GOTO 400\n"},
{300, "FOR I=1 TO L: IF D$(I)=\"-\" THEN 320\n"},
{310, "NEXT I: GOTO 390\n"},
{320, "PRINT: FOR I=1 TO L: PRINT D$(I);: NEXT I: PRINT: PRINT\n"},
{330, "INPUT \"WHAT IS YOUR GUESS FOR THE WORD\";B$\n"},
{340, "IF A$=B$ THEN 360\n"},
{350, "PRINT \"WRONG.  TRY ANOTHER LETTER.\": PRINT: GOTO 170\n"},
{360, "PRINT \"RIGHT!!  IT TOOK YOU\";T1;\"GUESSES!\"\n"},
{370, "INPUT \"WANT ANOTHER WORD\";W$: IF W$=\"YES\" THEN 50\n"},
{380, "PRINT: PRINT \"IT'S BEEN FUN!  BYE FOR NOW.\": GOTO 999\n"},
{390, "PRINT \"YOU FOUND THE WORD!\": GOTO 370\n"},
{400, "PRINT: PRINT: PRINT\"SORRY, THAT LETTER ISN'T IN THE WORD.\"\n"},
{410, "ON M GOTO 415,420,425,430,435,440,445,450,455,460\n"},
{415, "PRINT \"FIRST, WE DRAW A HEAD\": GOTO 470\n"},
{420, "PRINT \"NOW WE DRAW A BODY.\": GOTO 470\n"},
{425, "PRINT \"NEXT WE DRAW AN ARM.\": GOTO 470\n"},
{430, "PRINT \"THIS TIME IT'S THE OTHER ARM.\": GOTO 470\n"},
{435, "PRINT \"NOW, LET'S DRAW THE RIGHT LEG.\": GOTO 470\n"},
{440, "PRINT \"THIS TIME WE DRAW THE LEFT LEG.\": GOTO 470\n"},
{445, "PRINT \"NOW WE PUT UP A HAND.\": GOTO 470\n"},
{450, "PRINT \"NEXT THE OTHER HAND.\": GOTO 470\n"},
{455, "PRINT \"NOW WE DRAW ONE FOOT\": GOTO 470\n"},
{460, "PRINT \"HERE'S THE OTHER FOOT -- YOU'RE HUNG!!\"\n"},
{470, "ON M GOTO 480,490,500,510,520,530,540,550,560,570\n"},
{480, "P$(3,6)=\"-\": P$(3,7)=\"-\": P$(3,8)=\"-\": P$(4,5)=\"(\": P$(4,6)=\".\"\n"},
{481, "P$(4,8)=\".\":P$(4,9)=\")\":P$(5,6)=\"-\":P$(5,7)=\"-\":P$(5,8)=\"-\":GOTO 580\n"},
{490, "FOR I=6 TO 9: P$(I,7)=\"X\": NEXT I: GOTO 580\n"},
{500, "FOR I=4 TO 7: P$(I,I-1)=\"\\": NEXT I: GOTO 580\n"},
{510, "P$(4,11)=\"/\": P$(5,10)=\"/\": P$(6,9)=\"/\": P$(7,8)=\"/\": GOTO 580\n"},
{520, "P$(10,6)=\"/\": P$(11,5)=\"/\": GOTO 580\n"},
{530, "P$(10,8)=\"\\": P$(11,9)=\"\\": GOTO 580\n"},
{540, "P$(3,11)=\"\\": GOTO 580\n"},
{550, "P$(3,3)=\"/\": GOTO 580\n"},
{560, "P$(12,10)=\"\\": P$(12,11)=\"-\": GOTO 580\n"},
{570, "P$(12,3)=\"-\": P$(12,4)=\"/\"\n"},
{580, "FOR I=1 TO 12: FOR J=1 TO 12: PRINT P$(I,J);: NEXT J\n"},
{590, "PRINT: NEXT I: PRINT: PRINT: IF M<>10 THEN 170\n"},
{600, "PRINT \"SORRY, YOU LOSE.  THE WORD WAS \";A$\n"},
{610, "PRINT \"YOU MISSED THAT ONE.  DO YOU \";: GOTO 370\n"},
{620, "INPUT \"TYPE YES OR NO\";Y$: IF LEFT$(Y$,1)=\"Y\" THEN 50\n"},
{700, "DATA \"GUM\",\"SIN\",\"FOR\",\"CRY\",\"LUG\",\"BYE\",\"FLY\"\n"},
{710, "DATA \"UGLY\",\"EACH\",\"FROM\",\"WORK\",\"TALK\",\"WITH\",\"SELF\"\n"},
{720, "DATA \"PIZZA\",\"THING\",\"FEIGN\",\"FIEND\",\"ELBOW\",\"FAULT\",\"DIRTY\"\n"},
{730, "DATA \"BUDGET\",\"SPIRIT\",\"QUAINT\",\"MAIDEN\",\"ESCORT\",\"PICKAX\"\n"},
{740, "DATA \"EXAMPLE\",\"TENSION\",\"QUININE\",\"KIDNEY\",\"REPLICA\",\"SLEEPER\"\n"},
{750, "DATA \"TRIANGLE\",\"KANGAROO\",\"MAHOGANY\",\"SERGEANT\",\"SEQUENCE\"\n"},
{760, "DATA \"MOUSTACHE\",\"DANGEROUS\",\"SCIENTIST\",\"DIFFERENT\",\"QUIESCENT\"\n"},
{770, "DATA \"MAGISTRATE\",\"ERRONEOUSLY\",\"LOUDSPEAKER\",\"PHYTOTOXIC\"\n"},
{780, "DATA \"MATRIMONIAL\",\"PARASYMPATHOMIMETIC\",\"THIGMOTROPISM\"\n"},
{990, "PRINT \"BYE NOW\"\n"},
{999, "END\n"},
{},
};

#include <avr/pgmspace.h>
#include "programs.h"
const PROGMEM line program_reverse[] = {
{10, "PRINT TAB(32);\"REVERSE\"\n"},
{20, "PRINT TAB(15);\"CREATIVE COMPUTING  MORRISTOWN, NEW JERSEY\"\n"},
{30, "PRINT:PRINT:PRINT\n"},
{100, "PRINT \"REVERSE -- A GAME OF SKILL\": PRINT\n"},
{130, "DIM A(20)\n"},
{140, "REM *** N=NUMBER OF NUMBERS\n"},
{150, "N=9\n"},
{160, "PRINT \"DO YOU WANT THE RULES\";\n"},
{170, "INPUT A$\n"},
{180, "IF A$=\"NO\" THEN 210\n"},
{190, "GOSUB 710\n"},
{200, "REM *** MAKE A RANDOM LIST A(1) TO A(N)\n"},
{210, "A(1)=INT((N-1)*RND(1)+2)\n"},
{220, "FOR K=2 TO N\n"},
{230, "A(K)=INT(N*RND(1)+1)\n"},
{240, "FOR J=1 TO K-1\n"},
{250, "IF A(K)=A(J) THEN 230\n"},
{260, "NEXT J:NEXT K\n"},
{280, "REM *** PRINT ORIGINAL LIST AND START GAME\n"},
{290, "PRINT: PRINT \"HERE WE GO ... THE LIST IS: \"\n"},
{310, "T=0\n"},
{320, "GOSUB 610\n"},
{330, "PRINT \"HOW MANY SHALL I REVERSE\";\n"},
{340, "INPUT R\n"},
{350, "IF R=0 THEN 520\n"},
{360, "IF R<=N THEN 390\n"},
{370, "PRINT \"OOPS! TOO MANY! I CAN REVERSE AT MOST \";N:GOTO 330\n"},
{390, "T=T+1\n"},
{400, "REM *** REVERSE R NUMBERS AND PRINT NEW LIST\n"},
{410, "FOR K=1 TO INT(R/2)\n"},
{420, "Z=A(K)\n"},
{430, "A(K)=A(R-K+1)\n"},
{440, "A(R-K+1)=Z\n"},
{450, "NEXT K\n"},
{460, "GOSUB 610\n"},
{470, "REM *** CHECK FOR A WIN\n"},
{480, "FOR K=1 TO N\n"},
{490, "IF A(K)<>K THEN 330\n"},
{500, "NEXT K\n"},
{510, "PRINT \"YOU WON IT IN \";T;\" MOVES!!!\":PRINT\n"},
{520, "PRINT\n"},
{530, "PRINT \"TRY AGAIN (YES OR NO)\";\n"},
{540, "INPUT A$\n"},
{550, "IF A$=\"YES\" THEN 210\n"},
{560, "PRINT: PRINT \"O.K. HOPE YOU HAD FUN!!\":GOTO 999\n"},
{600, "REM *** SUBROUTINE TO PRINT LIST\n"},
{610, "PRINT:FOR K=1 TO N:PRINT A(K);:NEXT K\n"},
{650, "PRINT:PRINT:RETURN\n"},
{700, "REM *** SUBROUTINE TO PRINT THE RULES\n"},
{710, "PRINT:PRINT \"THIS IS THE GAME OF 'REVERSE'.  TO WIN, ALL YOU HAVE\"\n"},
{720, "PRINT \"TO DO IS ARRANGE A LIST OF NUMBERS (1 THROUGH \";N;\")\"\n"},
{730, "PRINT \"IN NUMERICAL ORDER FROM LEFT TO RIGHT.  TO MOVE, YOU\"\n"},
{740, "PRINT \"TELL ME HOW MANY NUMBERS (COUNTING FROM THE LEFT) TO\"\n"},
{750, "PRINT \"REVERSE.  FOR EXAMPLE, IF THE CURRENT LIST IS:\"\n"},
{760, "PRINT:PRINT \"2 3 4 5 1 6 7 8 9\"\n"},
{770, "PRINT:PRINT \"AND YOU REVERSE 4, THE RESULT WILL BE:\"\n"},
{780, "PRINT:PRINT \"5 4 3 2 1 6 7 8 9\"\n"},
{790, "PRINT:PRINT \"NOW IF YOU REVERSE 5, YOU WIN!\"\n"},
{800, "PRINT:PRINT \"1 2 3 4 5 6 7 8 9\":PRINT\n"},
{810, "PRINT \"NO DOUBT YOU WILL LIKE THIS GAME, BUT\"\n"},
{820, "PRINT \"IF YOU WANT TO QUIT, REVERSE 0 (ZERO).\":PRINT: RETURN\n"},
{999, "END\n"},
{},
};

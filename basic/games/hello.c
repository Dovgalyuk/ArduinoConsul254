#include <avr/pgmspace.h>
#include "programs.h"
const PROGMEM line program_hello[] = {
{2, "PRINT TAB(33);\"HELLO\"\n"},
{4, "PRINT TAB(15);\"CREATIVE COMPUTING  MORRISTOWN, NEW JERSEY\"\n"},
{6, "PRINT: PRINT: PRINT\n"},
{10, "PRINT \"HELLO.  MY NAME IS CREATIVE COMPUTER.\"\n"},
{20, "PRINT: PRINT: INPUT \"WHAT'S YOUR NAME\";N$: PRINT\n"},
{30, "PRINT \"HI THERE, \";N$;\", ARE YOU ENJOYING YOURSELF HERE\";\n"},
{40, "INPUT B$: PRINT\n"},
{50, "IF B$=\"YES\" THEN 70\n"},
{55, "IF B$=\"NO\" THEN 80\n"},
{60, "PRINT N$;\", I DON'T UNDERSTAND YOUR ANSWER OF '\";B$;\"'.\"\n"},
{65, "PRINT \"PLEASE ANSWER 'YES' OR 'NO'.  DO YOU LIKE IT HERE\";: GOTO 40\n"},
{70, "PRINT \"I'M GLAD TO HEAR THAT, \";N$;\".\": PRINT\n"},
{75, "GOTO 100\n"},
{80, "PRINT \"OH, I'M SORRY TO HEAR THAT, \";N$;\". MAYBE WE CAN\"\n"},
{85, "PRINT \"BRIGHTEN UP YOUR VISIT A BIT.\"\n"},
{100, "PRINT\n"},
{105, "PRINT \"SAY, \";N$;\", I CAN SOLVE ALL KINDS OF PROBLEMS EXCEPT\"\n"},
{110, "PRINT \"THOSE DEALING WITH GREECE.  WHAT KIND OF PROBLEMS DO\"\n"},
{120, "PRINT \"YOU HAVE (ANSWER SEX, HEALTH, MONEY, OR JOB)\";\n"},
{125, "INPUT C$\n"},
{126, "PRINT\n"},
{130, "IF C$=\"SEX\" THEN 200\n"},
{132, "IF C$=\"HEALTH\" THEN 180\n"},
{134, "IF C$=\"MONEY\" THEN 160\n"},
{136, "IF C$=\"JOB\" THEN 145\n"},
{138, "PRINT \"OH, \";N$;\", YOUR ANSWER OF \";C$;\" IS GREEK TO ME.\"\n"},
{140, "GOTO 250\n"},
{145, "PRINT \"I CAN SYMPATHIZE WITH YOU \";N$;\".  I HAVE TO WORK\"\n"},
{148, "PRINT \"VERY LONG HOURS FOR NO PAY -- AND SOME OF MY BOSSES\"\n"},
{150, "PRINT \"REALLY BEAT ON MY KEYBOARD.  MY ADVICE TO YOU, \";N$;\",\"\n"},
{153, "PRINT \"IS TO OPEN A RETAIL COMPUTER STORE.  IT'S GREAT FUN.\"\n"},
{155, "GOTO 250\n"},
{160, "PRINT \"SORRY, \";N$;\", I'M BROKE TOO.  WHY DON'T YOU SELL\"\n"},
{162, "PRINT \"ENCYCLOPEADIAS OR MARRY SOMEONE RICH OR STOP EATING\"\n"},
{164, "PRINT \"SO YOU WON'T NEED SO MUCH MONEY?\"\n"},
{170, "GOTO 250\n"},
{180, "PRINT \"MY ADVICE TO YOU \";N$;\" IS:\"\n"},
{185, "PRINT \"     1.  TAKE TWO ASPRIN\"\n"},
{188, "PRINT \"     2.  DRINK PLENTY OF FLUIDS (ORANGE JUICE, NOT BEER!)\"\n"},
{190, "PRINT \"     3.  GO TO BED (ALONE)\"\n"},
{195, "GOTO 250\n"},
{200, "INPUT \"IS YOUR PROBLEM TOO MUCH OR TOO LITTLE\";D$: PRINT\n"},
{210, "IF D$=\"TOO MUCH\" THEN 220\n"},
{212, "IF D$=\"TOO LITTLE\" THEN 230\n"},
{215, "PRINT \"DON'T GET ALL SHOOK, \";N$;\", JUST ANSWER THE QUESTION\"\n"},
{217, "INPUT \"WITH 'TOO MUCH' OR 'TOO LITTLE'.  WHICH IS IT\";D$:GOTO 210\n"},
{220, "PRINT \"YOU CALL THAT A PROBLEM?!!  I SHOULD HAVE SUCH PROBLEMS!\"\n"},
{225, "PRINT \"IF IT BOTHERS YOU, \";N$;\", TAKE A COLD SHOWER.\"\n"},
{228, "GOTO 250\n"},
{230, "PRINT \"WHY ARE YOU HERE IN SUFFERN, \";N$;\"?  YOU SHOULD BE\"\n"},
{235, "PRINT \"IN TOKYO OR NEW YORK OR AMSTERDAM OR SOMEPLACE WITH SOME\"\n"},
{240, "PRINT \"REAL ACTION.\"\n"},
{250, "PRINT\n"},
{255, "PRINT \"ANY MORE PROBLEMS YOU WANT SOLVED, \";N$;\n"},
{260, "INPUT E$: PRINT\n"},
{270, "IF E$=\"YES\" THEN 280\n"},
{273, "IF E$=\"NO\" THEN 300\n"},
{275, "PRINT \"JUST A SIMPLE 'YES' OR 'NO' PLEASE, \";N$;\".\"\n"},
{277, "GOTO 255\n"},
{280, "PRINT \"WHAT KIND (SEX, MONEY, HEALTH, JOB)\";\n"},
{282, "GOTO 125\n"},
{300, "PRINT\n"},
{302, "PRINT \"THAT WILL BE $5.00 FOR THE ADVICE, \";N$;\".\"\n"},
{305, "PRINT \"PLEASE LEAVE THE MONEY ON THE TERMINAL.\"\n"},
{307, "FOR I=1 TO 2000: NEXT I\n"},
{310, "PRINT: PRINT: PRINT\n"},
{315, "PRINT \"DID YOU LEAVE THE MONEY\";\n"},
{320, "INPUT G$: PRINT\n"},
{325, "IF G$=\"YES\" THEN 350\n"},
{330, "IF G$=\"NO\" THEN 370\n"},
{335, "PRINT \"YOUR ANSWER OF '\";G$;\"' CONFUSES ME, \";N$;\".\"\n"},
{340, "PRINT \"PLEASE RESPOND WITH 'YES' OR 'NO'.\": GOTO 315\n"},
{350, "PRINT \"HEY, \";N$;\"??? YOU LEFT NO MONEY AT ALL!\"\n"},
{355, "PRINT \"YOU ARE CHEATING ME OUT OF MY HARD-EARNED LIVING.\"\n"},
{360, "PRINT:PRINT \"WHAT A RIP OFF, \";N$;\"!!!\":PRINT\n"},
{365, "GOTO 385\n"},
{370, "PRINT \"THAT'S HONEST, \";N$;\", BUT HOW DO YOU EXPECT\"\n"},
{375, "PRINT \"ME TO GO ON WITH MY PSYCHOLOGY STUDIES IF MY PATIENTS\"\n"},
{380, "PRINT \"DON'T PAY THEIR BILLS?\"\n"},
{385, "PRINT:PRINT \"TAKE A WALK, \";N$;\".\":PRINT:PRINT:GOTO 999\n"},
{390, "PRINT \"NICE MEETING YOU, \";N$;\", HAVE A NICE DAY.\"\n"},
{400, "REM\n"},
{999, "END\n"},
{},
};
